## config/west.yml
```yaml
manifest:
  remotes:
    - name: zmkfirmware
      url-base: https://github.com/zmkfirmware

    - name: mihirsoni826
      url-base: https://github.com/mihirsoni826

  projects:
    - name: zmk
      remote: zmkfirmware
      revision: v0.3
      import: app/west.yml

    - name: nice-luffy-gear-five
      remote: mihirsoni826
      revision: main

    - name: nice-view-luffy-dog
      remote: mihirsoni826
      revision: main

  self:
    path: config
```
